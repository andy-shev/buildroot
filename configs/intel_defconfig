## configs/intel_defconfig
```kconfig
# SPDX-License-Identifier: GPL-2.0

# Architecture
BR2_i386=y
BR2_x86_i586=y

# Common
BR2_TOOLCHAIN_BUILDROOT_WCHAR=y

# Misc
BR2_ROOTFS_DEVICE_CREATION_DYNAMIC_MDEV=y
BR2_TARGET_GENERIC_GETTY_PORT="ttyS0"
BR2_TARGET_GENERIC_GETTY_BAUDRATE_115200=y

# Root FS hooks
BR2_ROOTFS_POST_BUILD_SCRIPT="board/intel/common/post-build.sh"
BR2_ROOTFS_POST_IMAGE_SCRIPT="board/intel/common/post-image.sh"
BR2_ROOTFS_POST_SCRIPT_ARGS=""

# Packages
BR2_PACKAGE_KEXEC=y
BR2_PACKAGE_KEXEC_ZLIB=y
BR2_PACKAGE_PCIUTILS=y
BR2_PACKAGE_LRZSZ=y
BR2_PACKAGE_SCREEN=y
BR2_PACKAGE_EFIBOOTMGR=y

# Root FS
BR2_TARGET_ROOTFS_CPIO=y
BR2_TARGET_ROOTFS_CPIO_BZIP2=y
# BR2_TARGET_ROOTFS_TAR is not set

# Host tools
BR2_PACKAGE_HOST_ACPICA=y
BR2_PACKAGE_HOST_DOSFSTOOLS=y
BR2_PACKAGE_HOST_MTOOLS=y
BR2_PACKAGE_HOST_PARTED=y
```

## package/acpica/Config.in.host
```kconfig
config BR2_PACKAGE_HOST_ACPICA
	bool "host acpica"
	help
	  The ACPI Component Architecture (ACPICA) project provides an
	  operating system (OS)-independent reference implementation of
	  the Advanced Configuration and Power Interface Specification
	  (ACPI).

	  https://www.acpica.org
```

## package/hid-replay/Config.in
```kconfig
config BR2_PACKAGE_HID_REPLAY
	bool "hid-replay"
	help
	  HID recorder for Linux

	  http://bentiss.github.io/hid-replay-docs/
```

## package/hid-tools/Config.in
```kconfig
config BR2_PACKAGE_HID_TOOLS
	bool "hid-tools"
	select BR2_PACKAGE_PYTHON_PARSE
	select BR2_PACKAGE_PYTHON_LIBEVDEV
	depends on BR2_PACKAGE_PYTHON_PYUDEV
	help
	  Add HID (Human Input Devices) debugging tools for linux kernel.

	  https://gitlab.freedesktop.org/libevdev/hid-tools

comment "hid-tools requires python-pyudev"
	depends on !BR2_PACKAGE_PYTHON_PYUDEV
```

## package/kernel-tools/Config.in
```kconfig
config BR2_PACKAGE_KERNEL_TOOLS
	bool "kernel-tools"
	help
	  Build tools listed in BOARD_INTEL_KERNEL_TOOLS
```

## package/python-parse/Config.in
```kconfig
config BR2_PACKAGE_PYTHON_PARSE
	bool "python-parse"
	help
	  parse() is the opposite of format().

	  https://github.com/r1chardj0n3s/parse
```
